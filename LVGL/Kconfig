## LVGL/Kconfig
```kconfig
menu "Graphics Library Selection"
    config LVGL_ENABLE
        bool "Enable LVGL Graphics Library"
        default n
        help
            Enable LVGL for graphical user interface.
            Disable this to exclude LVGL completely.

    if LVGL_ENABLE
        choice
            prompt "LVGL Version"
            default LVGL_9_3
            help
                Select the version of LVGL graphics library.

            config LVGL_9_3
                bool "LVGL 9.3"
                select LIBJPEG_TURBO_ENABLE
                help
                    Use LVGL 9.3.

            config LVGL_9_6
                bool "LVGL 9.6"
                select LIBJPEG_TURBO_ENABLE
                help
                    Use LVGL 9.6.
        endchoice
    endif

    if LVGL_9_3 || LVGL_9_6
        config LV_DEMO_ENABLE
            bool "Enable LVGL Demo"
            default n
            help
                Enable an LVGL demo. When disabled, no demo is selected.

        if LV_DEMO_ENABLE
            choice
                prompt "LVGL Demos"
                default LV_DEMO_WIDGETS
                help
                    Select the demo for LVGL

                config LV_DEMO_WIDGETS
                    bool "lv demo widgets"
                    help
                        Show some widget.

                config LV_DEMO_STRESS
                    bool "lv demo stress"
                    help
                        Stress test for LVGL

                config LV_DEMO_MUSIC
                    bool "lv demo music"
                    help
                        Music player demo

                config LV_DEMO_BENCHMARK
                    bool "lv demo benchmark"
                    help
                        Benchmark your system

                config LV_DEMO_IMAGE_DECODER
                    bool "lv demo image decoder"
                    select APP_FRAMEWORKS_ENABLE
                    help
                        Visual decoder demo: displays BMP/JPEG/PNG/QOI decoded on screen.
            endchoice
        endif

    endif
endmenu
```
